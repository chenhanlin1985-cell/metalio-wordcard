// Generated by tools/dictionary_course_notes.py from adult 1.0 course CSVs.
// {"assets\\adult-courses\\daily.csv": "187516d5b47d14bbed925eca7403d6ad9e949e431c1e0adbc9bf15b1754c9c9a", "assets\\adult-courses\\tech.csv": "ef8595f1e843e961720725948815526b5a843bf148498628b27ee25b0b583f38", "assets\\adult-courses\\work.csv": "9eeb823fc7c6b92fe19d8703b4099b4ec2252e96c9012c8fe4004909525b5826"}
static const CourseNote course_notes[] = {
    {"appointment","əˈpɔɪntmənt","n. 约定；预约\n用法：have an appointment：有一个预约"},
    {"available","əˈveɪləbəl","adj. 有空的；可以安排时间的\n用法：available on Friday：周五有空\nadj. 有空的；可安排时间的\n用法：available to discuss：有空讨论"},
    {"block","blɑːk","v. 阻碍；使无法继续\n用法：block the next step：阻碍下一步工作"},
    {"cache","kæʃ","n. 缓存\n用法：a cache：一处缓存；读音与 cash 相同"},
    {"clarify","ˈklɛrəfaɪ","v. 澄清；说明清楚\n用法：clarify the details：把细节说清楚"},
    {"command","kəˈmænd","n. 命令；计算机指令\n用法：run a command：执行命令"},
    {"compatible","kəmˈpætəbəl","adj. 兼容的\n用法：compatible with：与……兼容"},
    {"complete","kəmˈpliːt","adj. 已完成的；完整的\n用法：The first part is complete：第一部分已完成"},
    {"confirm","kənˈfɝːm","v. 确认\n用法：confirm the time：确认时间\nv. 确认\n用法：confirm by email：通过邮件确认"},
    {"connection","kəˈnɛkʃən","n. 连接；连接状态\n用法：check the connection：检查连接"},
    {"crash","kræʃ","v. 崩溃；突然停止正常运行\n用法：the device crashes：设备崩溃；此处不是碰撞"},
    {"deadline","ˈdɛdlaɪn","n. 截止时间；最后期限\n用法：extend the deadline：延后截止时间"},
    {"default","dɪˈfɔːlt","adj. 默认的；预设的\n用法：default setting：默认设置；by default：默认情况下"},
    {"delay","dɪˈleɪ","n. 延误；延期\n用法：a delay：一次延误；本卡为名词"},
    {"device","dɪˈvaɪs","n. 设备；装置\n用法：this device：这台设备"},
    {"directions","dɪˈrɛkʃənz","n. pl. 路线说明；指路信息\n用法：ask for directions：问路"},
    {"driver","ˈdraɪvɚ","n. 驱动程序\n用法：install a driver：安装驱动；此处不是司机"},
    {"enable","ɪˈneɪbəl","v. 启用；使可用\n用法：enable an option：启用一个选项"},
    {"error","ˈɛrɚ","n. 错误；故障信息\n用法：an error message：一条错误消息"},
    {"estimate","ˈɛstəmət","n. 估计；估算\n用法：an estimate for the work：对工作量的估算；本卡为名词"},
    {"exchange","ɪksˈtʃeɪndʒ","v. 换货；交换\n用法：exchange it for another size：换一个尺码"},
    {"extend","ɪkˈstɛnd","v. 延长；延后\n用法：extend the deadline：延后截止时间"},
    {"feature","ˈfiːtʃɚ","n. 功能；特性\n用法：search feature：搜索功能"},
    {"feedback","ˈfiːdbæk","n. 反馈意见（不可数）\n用法：give feedback：提供反馈"},
    {"firmware","ˈfɝːmwɛr","n. 固件\n用法：firmware update：固件更新"},
    {"fit","fɪt","v. 大小合适；合身\n用法：This shirt does not fit：这件衬衫不合身"},
    {"folder","ˈfoʊldɚ","n. 文件夹\n用法：open a folder：打开文件夹"},
    {"install","ɪnˈstɔːl","v. 安装（软件或设备）\n用法：install an app：安装应用"},
    {"issue","ˈɪʃuː","n. 问题；需要处理的事项\n用法：an issue with the search：搜索方面的问题；此处不是期刊"},
    {"latency","ˈleɪtənsi","n. 延迟；从请求到响应的等待时间\n用法：reduce latency：降低延迟"},
    {"log","lɔːɡ","n. 日志；运行记录\n用法：save the log：保存日志；此处不是木头"},
    {"luggage","ˈlʌɡɪdʒ","n. 行李（不可数）\n用法：my luggage：我的行李；不用 a luggage"},
    {"mean","miːn","v. 意思是；意指\n用法：What does it mean?：它是什么意思？"},
    {"memory","ˈmɛmɚi","n. 内存\n用法：use more memory：使用更多内存；此处不是人的记忆"},
    {"morning","ˈmɔːrnɪŋ","n. 早晨；上午\n用法：on Monday morning：在周一上午"},
    {"nearby","ˌnɪrˈbaɪ","adv. 在附近\n用法：a station nearby：附近有一个车站"},
    {"next step","nɛkst stɛp","n. phr. 下一步；接下来的行动\n用法：the next step：下一步"},
    {"pending","ˈpɛndɪŋ","adj. 待处理的；尚未完成的\n用法：still pending：仍待处理"},
    {"permission","pɚˈmɪʃən","n. 许可；访问权限\n用法：have permission：有权限"},
    {"platform","ˈplætfɔːrm","n. 站台\n用法：platform two：二号站台；本课不是软件平台"},
    {"priority","praɪˈɔːrəti","n. 优先事项；优先级\n用法：top priority：最优先的事项"},
    {"progress","ˈprɑːɡrɛs","n. 进展；进度\n用法：a progress report：一份进度报告；本卡为名词"},
    {"pronounce","prəˈnaʊns","v. 发音；读出\n用法：pronounce a word：读出一个词"},
    {"receipt","rɪˈsiːt","n. 收据；付款凭证\n用法：keep the receipt：保留收据；p 不发音"},
    {"reduce","rɪˈduːs","v. 减少；降低\n用法：reduce the latency：降低延迟"},
    {"refund","ˈriːfʌnd","n. 退款；退还的款项\n用法：get a refund：获得退款；本卡为名词"},
    {"repeat","rɪˈpiːt","v. 重复；再说一遍\n用法：repeat that：把刚才的话再说一遍"},
    {"reproduce","ˌriːprəˈduːs","v. 复现（问题或故障）\n用法：reproduce the error：复现错误；此处不是繁殖"},
    {"requirement","rɪˈkwaɪrmənt","n. 需求；要求\n用法：clarify a requirement：澄清一项需求"},
    {"reschedule","ˌriːˈskɛdʒuːl","v. 重新安排时间；改期\n用法：reschedule a meeting：改会议时间"},
    {"resolve","rɪˈzɑːlv","v. 解决\n用法：resolve an issue：解决一个问题"},
    {"response","rɪˈspɑːns","n. 响应；回复\n用法：response time：响应时间"},
    {"restart","ˌriːˈstɑːrt","v. 重新启动\n用法：restart the app：重新启动应用；本卡为动词"},
    {"return","rɪˈtɝːn","v. 退还；退回\n用法：return an item：退回一件商品"},
    {"review","ˌriːˈvjuː","v. 检查；审查\n用法：review the log：检查日志；此处不是复习单词"},
    {"schedule","ˈskɛdʒuːl","n. 时间安排；日程\n用法：discuss the schedule：讨论时间安排"},
    {"scope of work","skoʊp əv wɝːk","n. phr. 工作范围\n用法：scope：范围；within the scope：在范围内"},
    {"setting","ˈsɛtɪŋ","n. 设置；配置选项\n用法：change a setting：更改一项设置"},
    {"size","saɪz","n. 尺码；尺寸\n用法：another size：另一个尺码"},
    {"slowly","ˈsloʊli","adv. 慢慢地；缓慢地\n用法：more slowly：再慢一些"},
    {"spell","spɛl","v. 拼写；拼读字母\n用法：spell a word：拼写一个词"},
    {"station","ˈsteɪʃən","n. 车站\n用法：train station：火车站"},
    {"suggest","səˈdʒɛst","v. 建议；提出\n用法：What do you suggest?：你有什么建议？"},
    {"task","tæsk","n. 任务\n用法：finish a task：完成一项任务"},
    {"trade-off","ˈtreɪdˌɔːf","n. 权衡；取舍\n用法：a reasonable trade-off：合理的取舍"},
    {"transfer","trænsˈfɝː","v. 换乘；转乘\n用法：need to transfer：需要换乘"},
    {"understand","ˌʌndɚˈstænd","v. 理解；听懂\n用法：understand the meaning：理解含义"},
    {"urgent","ˈɝːdʒənt","adj. 紧急的；急迫的\n用法：an urgent task：一项紧急任务"},
    {"version","ˈvɝːʒən","n. 版本\n用法：stable version：稳定版本"},
    {"work","wɝːk","v. 合适；行得通\n用法：Monday works for me：周一我方便"},
};
